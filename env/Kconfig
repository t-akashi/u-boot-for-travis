## env/Kconfig
```kconfig
menu "Environment"

config ENV_DRV_NONE
	bool
	default y if !ENV_DRV_EEPROM && !ENV_DRV_EXT4 && \
		     !ENV_DRV_FAT && !ENV_DRV_FLASH && \
		     !ENV_DRV_MMC && !ENV_DRV_NAND && \
		     !ENV_DRV_NVRAM && !ENV_DRV_ONENAND && \
		     !ENV_DRV_REMOTE && !ENV_DRV_SPI_FLASH && \
		     !ENV_DRV_UBI

config ENV_DRV_EEPROM
	bool

config ENV_DRV_FAT
	bool
	select FS_FAT
	select FAT_WRITE

config ENV_DRV_EXT4
	bool
	select EXT4_WRITE

config ENV_DRV_FLASH
	bool

config ENV_DRV_MMC
	bool
	depends on MMC

config ENV_DRV_NAND
	bool

config ENV_DRV_NVRAM
	bool

config ENV_DRV_ONENAND
	bool

config ENV_DRV_REMOTE
	bool

config ENV_DRV_SPI_FLASH
	bool

config ENV_DRV_UBI
	bool

source "env/Kconfig.uboot"

endmenu
```

## env/Kconfig.efi
```kconfig
if EFI_LOADER

menu "Configure UEFI context"

config ENV_EFI_IS_NOWHERE
	bool
	default y if !ENV_EFI_IS_INFLASH && !ENV_EFI_IS_IN_FAT

config ENV_EFI_IS_IN_FAT
	bool "EFI Environment is in a FAT filesystem"
	select ENV_DRV_FAT
	help
	  Define this if you want to use the FAT file system for
	  the environment.

config ENV_EFI_IS_IN_FLASH
	bool "EFI Environment in flash memory"
	select ENV_DRV_FLASH
	help
	  Define this if you have a flash device which you want to use
	  for the environment.

	  a) The environment occupies one whole flash sector, which is
	   "embedded" in the text segment with the U-Boot code. This
	   happens usually with "bottom boot sector" or "top boot
	   sector" type flash chips, which have several smaller
	   sectors at the start or the end. For instance, such a
	   layout can have sector sizes of 8, 2x4, 16, Nx32 kB. In
	   such a case you would place the environment in one of the
	   4 kB sectors - with U-Boot code before and after it. With
	   "top boot sector" type flash chips, you would put the
	   environment in one of the last sectors, leaving a gap
	   between U-Boot and the environment.

	  CONFIG_ENV_EFI_OFFSET:

	   Offset of environment data (variable area) to the
	   beginning of flash memory; for instance, with bottom boot
	   type flash chips the second sector can be used: the offset
	   for this sector is given here.

	   CONFIG_ENV_EFI_OFFSET is used relative to CONFIG_SYS_FLASH_BASE.

	  CONFIG_ENV_EFI_ADDR:

	   This is just another way to specify the start address of
	   the flash sector containing the environment (instead of
	   CONFIG_ENV_OFFSET).

	  CONFIG_ENV_EFI_SECT_SIZE:

	   Size of the sector containing the environment.


	  b) Sometimes flash chips have few, equal sized, BIG sectors.
	   In such a case you don't want to spend a whole sector for
	   the environment.

	  CONFIG_ENV_EFI_SIZE:

	   If you use this in combination with CONFIG_ENV_IS_IN_FLASH
	   and CONFIG_ENV_SECT_SIZE, you can specify to use only a part
	   of this flash sector for the environment. This saves
	   memory for the RAM copy of the environment.

	   It may also save flash memory if you decide to use this
	   when your environment is "embedded" within U-Boot code,
	   since then the remainder of the flash sector could be used
	   for U-Boot code. It should be pointed out that this is
	   STRONGLY DISCOURAGED from a robustness point of view:
	   updating the environment in flash makes it always
	   necessary to erase the WHOLE sector. If something goes
	   wrong before the contents has been restored from a copy in
	   RAM, your target system will be dead.

	  CONFIG_ENV_EFI_ADDR_REDUND
	  CONFIG_ENV_EFI_SIZE_REDUND

	   These settings describe a second storage area used to hold
	   a redundant copy of the environment data, so that there is
	   a valid backup copy in case there is a power failure during
	   a "saveenv" operation.

	  BE CAREFUL! Any changes to the flash layout, and some changes to the
	  source code will make it necessary to adapt <board>/u-boot.lds*
	  accordingly!

config ENV_EFI_FAT_INTERFACE
	string "Name of the block device for the environment"
	depends on ENV_EFI_IS_IN_FAT
	help
	  Define this to a string that is the name of the block device.

config ENV_EFI_FAT_DEVICE_AND_PART
	string "Device and partition for where to store the environment in FAT"
	depends on ENV_EFI_IS_IN_FAT
	help
	  Define this to a string to specify the partition of the device.
	  It can be as following:

	    "D:P", "D:0", "D", "D:" or "D:auto" (D, P are integers. And P >= 1)
	       - "D:P": device D partition P. Error occurs if device D has no
	                partition table.
	       - "D:0": device D.
	       - "D" or "D:": device D partition 1 if device D has partition
	                      table, or the whole device D if has no partition
	                      table.
	       - "D:auto": first partition in device D with bootable flag set.
	                   If none, first valid partition in device D. If no
	                   partition table then means device D.

config ENV_EFI_FAT_FILE
	string "Name of the FAT file to use for the environment"
	depends on ENV_EFI_IS_IN_FAT
	default "uboot_efi.env"
	help
	  It's a string of the FAT file name. This file use to store the
	  environment.

config ENV_EFI_ADDR
	hex "EFI Environment Address"
	help
	  Start address of the device (or partition)

config ENV_EFI_OFFSET
	hex "EFI Environment Offset"
	help
	  Offset from the start of the device (or partition)

config ENV_EFI_SIZE
	hex "EFI Environment Size"
	help
	  Size of the environment storage area

config ENV_EFI_SECT_SIZE
	hex "EFI Environment Sector-Size"
	help
	  Size of the sector containing the environment.

config ENV_EFI_ADDR_REDUND
	hex "EFI Environment Address for second area"
	help
	  Start address of the device (or partition)

config ENV_EFI_SIZE_REDUND
	hex "EFI Environment Size for second area"
	help
	  Size of the environment second storage area

endmenu

endif
```
